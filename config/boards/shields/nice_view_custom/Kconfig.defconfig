## config/boards/shields/nice_view_custom/Kconfig.defconfig
```kconfig
# Custom Nice!View widget configuration
# SPDX-License-Identifier: MIT

if SHIELD_NICE_VIEW_CUSTOM

config LV_Z_VDB_SIZE
    default 100

config LV_DPI_DEF
    default 161

config LV_Z_BITS_PER_PIXEL
    default 1

choice LV_COLOR_DEPTH
    default LV_COLOR_DEPTH_1
endchoice

choice ZMK_DISPLAY_WORK_QUEUE
    default ZMK_DISPLAY_WORK_QUEUE_DEDICATED
endchoice

choice ZMK_DISPLAY_STATUS_SCREEN
    default ZMK_DISPLAY_STATUS_SCREEN_CUSTOM
endchoice

config LV_Z_MEM_POOL_SIZE
    default 4096

config ZMK_DISPLAY_STATUS_SCREEN_CUSTOM
    imply NICE_VIEW_CUSTOM_WIDGET

config NICE_VIEW_CUSTOM_WIDGET
    bool "Custom nice!view widget"
    default y
    select LV_FONT_MONTSERRAT_26
    select LV_FONT_MONTSERRAT_18
    select LV_FONT_MONTSERRAT_16
    select LV_FONT_MONTSERRAT_14
    select LV_USE_IMG
    select LV_USE_CANVAS
    select ZMK_BATTERY_REPORTING
    select ZMK_BATTERY_REPORTING_FETCH_STATE_OF_CHARGE

endif # SHIELD_NICE_VIEW_CUSTOM
```

## config/boards/shields/nice_view_custom/Kconfig.shield
```kconfig
config SHIELD_NICE_VIEW_CUSTOM
    def_bool $(shields_list_contains,nice_view_custom)

if SHIELD_NICE_VIEW_CUSTOM
    depends on HAS_DTS
    depends on CONFIG_ZMK_DISPLAY
    depends on CONFIG_ZMK_BATTERY
endif
```
